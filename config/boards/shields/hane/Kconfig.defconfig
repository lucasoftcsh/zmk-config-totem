## config/boards/shields/hane/Kconfig.defconfig
```kconfig
# Copyright (c) 2022 The ZMK Contributors
# SPDX-License-Identifier: MIT

if SHIELD_HANE_LEFT

config ZMK_KEYBOARD_NAME
    default "HANE"
    
config ZMK_SPLIT_ROLE_CENTRAL
    default y

endif

if SHIELD_HANE_LEFT || SHIELD_HANE_RIGHT

config ZMK_SPLIT
    default y

endif
```
